# file: FS_F103RXT6_BASIC.ioc
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Mcu.Family=STM32F1
Mcu.Name=STM32F103R(C-D-E)Tx
Mcu.Package=LQFP64
NVIC.PriorityGroup=NVIC_PRIORITYGROUP_4
NVIC.TIM6_IRQn=true\:0\:0\:false\:false\:true\:true\:true
PA13.Mode=Serial_Wire
PA13.Signal=SYS_JTMS-SWDIO
PA14.Mode=Serial_Wire
PA14.Signal=SYS_JTCK-SWCLK
PA2.Signal=GPIO_Output
PC14-OSC32_IN.Mode=LSE-External-Oscillator
PC14-OSC32_IN.Signal=RCC_OSC32_IN
PC15-OSC32_OUT.Mode=LSE-External-Oscillator
PC15-OSC32_OUT.Signal=RCC_OSC32_OUT
PD0-OSC_IN.Mode=HSE-External-Oscillator
PD0-OSC_IN.Signal=RCC_OSC_IN
PD1-OSC_OUT.Mode=HSE-External-Oscillator
PD1-OSC_OUT.Signal=RCC_OSC_OUT
ProjectManager.HeapSize=0x200
ProjectManager.StackSize=0x400
ProjectManager.TargetToolchain=MDK-ARM V5.32
RCC.AHBFreq_Value=72000000
RCC.APB1CLKDivider=RCC_HCLK_DIV2
RCC.APB1Freq_Value=36000000
RCC.APB1TimFreq_Value=72000000
RCC.APB2Freq_Value=72000000
RCC.APB2TimFreq_Value=72000000
RCC.HCLKFreq_Value=72000000
RCC.PLLMUL=RCC_PLL_MUL9
RCC.PLLSourceVirtual=RCC_PLLSOURCE_HSE
RCC.SYSCLKFreq_VALUE=72000000
RCC.SYSCLKSource=RCC_SYSCLKSOURCE_PLLCLK
RCC.USBFreq_Value=72000000
TIM6.AutoReloadPreload=TIM_AUTORELOAD_PRELOAD_ENABLE
TIM6.Period=99
TIM6.Prescaler=7199
VP_TIM6_VS_ClockSourceINT.Mode=Enable_Timer
board=custom

// file: Core/Src/main.c
/* USER CODE BEGIN Header */
/**
  ******************************************************************************
  * @file           : main.c
  * @brief          : Main program body
  ******************************************************************************
  * @attention
  *
  * <h2><center>&copy; Copyright (c) 2021 STMicroelectronics.
  * All rights reserved.</center></h2>
  *
  * This software component is licensed by ST under BSD 3-Clause license,
  * the "License"; You may not use this file except in compliance with the
  * License. You may obtain a copy of the License at:
  *                        opensource.org/licenses/BSD-3-Clause
  *
  ******************************************************************************
  */
/* USER CODE END Header */
#include "main.h"
#include "tim.h"
#include "gpio.h"

void SystemClock_Config(void);

/* USER CODE BEGIN 0 */
/*
 * * change record:-->1
 * * time and author:21.10.4 lanxin
 * * what changed:创建初始版本。
 * * point:1.板子 FS_STM32F103RX_BoardV1.3  git----> git@gitee.com:lanxin980210/fs-share.git -->FS_BOARD-->FS_STM32F103RXT6_BOARD V1.3
 * * point:2.工程文件中的stm32f1xx_it.c增加了soft_timer的部分文件，其他未做修改。
 * * point:3.main.c中增加测试代码，其他未做修改。
 * * point:4.led 1000ms闪烁一次，五秒后熄灭。
 * * point:5.增加/删除定时器  开启/关闭定时器
 * * point:6. 这个模块使用tim_ops->timer_stop()也是可以关闭的，之后使用tim_ops->timer_start();可以重新开启
 */
#include "fs_soft_timer_driver.h"

c_soft_timer_t *my_timer_1 = 0x00;
c_soft_timer_t *my_timer_2 = 0x00;

void test(void *para);
void test2(void *para);

/* USER CODE END 0 */

int main(void)
{

  /* MCU Configuration--------------------------------------------------------*/

  /* Reset of all peripherals, Initializes the Flash interface and the Systick. */
  HAL_Init();

  /* Configure the system clock */
  SystemClock_Config();

  /* Initialize all configured peripherals */
  MX_GPIO_Init();
  MX_TIM6_Init();
  /* USER CODE BEGIN 2 */
  HAL_GPIO_WritePin(GPIOA, GPIO_PIN_2, GPIO_PIN_RESET); //初始化led gpio
                                                        /* 使能hard timer 6 */
  __HAL_TIM_ENABLE(&htim6);
  __HAL_TIM_ENABLE_IT(&htim6, TIM_IT_UPDATE);
  /* soft timer init */
  if (fs_soft_timer_module_init() != SOFT_TIMER_STATE_OK)
  {
    return 0; //表示soft timer module 不可用
  }

  my_timer_1 = tim_ops->add_new_timer(SOFT_TIMER_WORK_PERIOD, 1000, 0, test);                   //添加第一个timer
  my_timer_2 = tim_ops->add_new_timer(SOFT_TIMER_WORK_PERIOD, 5000, (void *)my_timer_1, test2); //通过第二个timer把第一个timer删了,关闭第二个定时器

  /* USER CODE END 2 */

  /* Infinite loop */
  while (1)
  {

    /* USER CODE BEGIN 3 */
    tim_ops->timer_handle();
  }
  /* USER CODE END 3 */
}

void SystemClock_Config(void)
{
  RCC_OscInitTypeDef RCC_OscInitStruct = {0};
  RCC_ClkInitTypeDef RCC_ClkInitStruct = {0};

  /** Initializes the RCC Oscillators according to the specified parameters
  * in the RCC_OscInitTypeDef structure.
  */
  RCC_OscInitStruct.OscillatorType = RCC_OSCILLATORTYPE_HSE;
  RCC_OscInitStruct.HSEState = RCC_HSE_ON;
  RCC_OscInitStruct.HSEPredivValue = RCC_HSE_PREDIV_DIV1;
  RCC_OscInitStruct.HSIState = RCC_HSI_ON;
  RCC_OscInitStruct.PLL.PLLState = RCC_PLL_ON;
  RCC_OscInitStruct.PLL.PLLSource = RCC_PLLSOURCE_HSE;
  RCC_OscInitStruct.PLL.PLLMUL = RCC_PLL_MUL9;
  if (HAL_RCC_OscConfig(&RCC_OscInitStruct) != HAL_OK)
  {
    Error_Handler();
  }
  /** Initializes the CPU, AHB and APB buses clocks
  */
  RCC_ClkInitStruct.ClockType = RCC_CLOCKTYPE_HCLK | RCC_CLOCKTYPE_SYSCLK | RCC_CLOCKTYPE_PCLK1 | RCC_CLOCKTYPE_PCLK2;
  RCC_ClkInitStruct.SYSCLKSource = RCC_SYSCLKSOURCE_PLLCLK;
  RCC_ClkInitStruct.AHBCLKDivider = RCC_SYSCLK_DIV1;
  RCC_ClkInitStruct.APB1CLKDivider = RCC_HCLK_DIV2;
  RCC_ClkInitStruct.APB2CLKDivider = RCC_HCLK_DIV1;

  if (HAL_RCC_ClockConfig(&RCC_ClkInitStruct, FLASH_LATENCY_2) != HAL_OK)
  {
    Error_Handler();
  }
}

/* USER CODE BEGIN 4 */
/*
 * *@ author:lanxin
 * *@ brief:my_timer_1的溢出中断处理函数
 * *@ note:翻转led的状态
 * *@ param:NONE
 * *@ retval:NONE
 */
void test(void *para)
{
  HAL_GPIO_TogglePin(GPIOA, GPIO_PIN_2);
}
/*
 * *@ author:lanxin
 * *@ brief:my_timer_2的溢出中断处理函数
 * *@ note:把第一个timer给删除了
 * *@ note:虽然设置的是周期性定时器，但是这进来后就关闭了该定时器，所以只会进来一次
 * *@ param:NONE
 * *@ retval:NONE
 */
void test2(void *para)
{
  c_soft_timer_t *tim = (c_soft_timer_t *)para; //转换传入的参数
  tim_ops->delete_timer(tim);
  tim_ops->timer_disable(my_timer_2);
  HAL_GPIO_WritePin(GPIOA, GPIO_PIN_2, GPIO_PIN_SET);
}
/* USER CODE END 4 */

void Error_Handler(void)
{
  __disable_irq();
  while (1)
  {
  }
}

/************************ (C) COPYRIGHT STMicroelectronics *****END OF FILE****/
